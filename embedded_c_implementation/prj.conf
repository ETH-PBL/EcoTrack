## CMakeLists.txt
```
# SPDX-License-Identifier: Apache-2.0

cmake_minimum_required(VERSION 3.20.0)
find_package(Zephyr REQUIRED HINTS $ENV{ZEPHYR_BASE})
project(algobenchmark)

target_sources(app PRIVATE
  src/main.c
  src/algorithm.c
  src/battery.c
  src/CycleCounter.c
)
```

## prj.conf
```kconfig
# Floats
CONFIG_MAIN_STACK_SIZE=4096

CONFIG_FPU=y
CONFIG_NEWLIB_LIBC_FLOAT_PRINTF=y
CONFIG_NEWLIB_LIBC=y
CONFIG_ADC=y

CONFIG_SPEED_OPTIMIZATIONS=y
```

## nrf52833dk_nrf52833.overlay
```dts
/* SPDX-License-Identifier: LicenseRef-Nordic-5-Clause */

/ {
	vbatt {
		compatible = "voltage-divider";
		io-channels = <&adc 3>;
		output-ohms = <18000>;
		full-ohms = <(5000 + 18000)>;
	};
};

&adc {
	status = "okay";
};
```

## src/main.c
```c
/* main - Application main entry point */

/*
 * Copyright (c) 2015-2016 Intel Corporation
 *
 * SPDX-License-Identifier: Apache-2.0
 */

#include <errno.h>
#include <stddef.h>
#include <stdint.h>
#include <string.h>
#include <zephyr/kernel.h>
#include <zephyr/logging/log.h>

#include "CycleCounter.h"
#include "algorithm.h"
#include "battery.h"
#include <zephyr/drivers/gpio.h>

/** A discharge curve specific to the power source. */
static const struct battery_level_point levels[] = {
    /* "Curve" here eyeballed from captured data for the [Adafruit
     * 3.7v 2000 mAh](https://www.adafruit.com/product/2011) LIPO
     * under full load that started with a charge of 3.96 V and
     * dropped about linearly to 3.58 V over 15 hours.  It then
     * dropped rapidly to 3.10 V over one hour, at which point it
     * stopped transmitting.
     *
     * Based on eyeball comparisons we'll say that 15/16 of life
     * goes between 3.95 and 3.55 V, and 1/16 goes between 3.55 V
     * and 3.1 V.
     */

    {10000, 3950},
    {625, 3550},
    {0, 3100},
};

LOG_MODULE_REGISTER(MAIN);

/* The devicetree node identifier for the "led0" alias. */
#define LED0_NODE DT_ALIAS(led0)

/*
 * A build error on this line means your board is unsupported.
 * See the sample documentation for information on how to fix this.
 */
const struct gpio_dt_spec led = GPIO_DT_SPEC_GET(LED0_NODE, gpios);

int main(void) {
  int ret;

  // Initialize all peripherals
  if (!device_is_ready(led.port)) {
    LOG_ERR("LED Dev not read!");
    return -1;
  }

  ret = gpio_pin_configure_dt(&led, GPIO_OUTPUT_ACTIVE);
  if (ret != 0) {
    LOG_ERR("Failed to configure LED (err %d)", ret);
    return ret;
  }

  struct algorithm_state state = {0};
  state.parameters.beta1 = -0.203;
  state.parameters.beta2 = 0.468;
  state.parameters.gamma = 0.67;

  fsm_init(&state, 11.4, 1);
  
  k_sleep(K_MSEC(1000));
  while (true) {
    init_timer();
    start_timer();
    int batt_mV = battery_sample();
    stop_timer();
    
    if (batt_mV < 0) {
      LOG_ERR("Failed to read battery voltage: %d", batt_mV);
      break;
    }

    int adc_cycles = get_cycles();
    batt_mV = batt_mV > 1263600000 ? 0 : batt_mV;
    init_timer();
    start_timer();
    unsigned int batt_pptt = battery_level_pptt(batt_mV, levels);
    float bat = batt_pptt / 100.0;
    stop_timer();

    int conversion = get_cycles();
    
    init_timer();
    //gpio_pin_set_dt(&led, 1);
    start_timer();
    int k = update_algorithm(&state, bat);
    stop_timer();
    int algorithm_cycles = get_cycles();
    //gpio_pin_set_dt(&led, 0);
    LOG_INF("%d mV (%d); %u pptt (%d); %d is k (%d)", batt_mV, adc_cycles, batt_pptt, conversion, k, algorithm_cycles);

    /* Burn battery so you can see that this works over time */
    k_sleep(K_MSEC(1000));
  }
}
```

## src/CycleCounter.c
```c
/*
 * ==========================================================================================================
 * @file    CycleCounter.c
 * @authors Silvano Cortesi
 * @copyright  "(c) 2020. ETH Zurich.
 * @date    05-May-2020
 *
 * Copyright   : (c) 2020.  Silvano Cortesi & Stephan Boner, ETH Zurich. All
 * rights reserved
 *
 * Description : functions to measure cycles.
 *
 * ============================================================================================================
 */

#include "CycleCounter.h"

void init_timer() {
#ifdef CONFIG_CPU_CORTEX_M7
  *DWT_LAR = 0xC5ACCE55;
#endif
  *SCB_DEMCR |= 0x01000000;
  *DWT_CYCCNT = 0; // reset the counter
  *DWT_CONTROL &= ~1;
}

void start_timer() {
  init_timer();
  *DWT_CONTROL |= 1; // enable the counter
}

void stop_timer() {
  *DWT_CONTROL &= ~1; // disable the counter
}

uint32_t get_cycles() { return *DWT_CYCCNT; }
```

## src/CycleCounter.h
```c
/*
 * ==========================================================================================================
 * @file    CycleCounter.h
 * @authors Silvano Cortesi
 * @copyright  "(c) 2020. ETH Zurich.
 * @date    05-May-2020
 *
 * Copyright   : (c) 2020.  Silvano Cortesi & Stephan Boner, ETH Zurich. All
 * rights reserved
 *
 * Description : functions to measure cycles.
 *
 * ============================================================================================================
 */

#ifndef CycleCounter_H
#define CycleCounter_H

#include <stdint.h>

#ifdef CONFIG_CPU_CORTEX_M7
static unsigned int *DWT_LAR = (unsigned int *)0xE0001FB0;
#endif

static unsigned int *DWT_CYCCNT =
    (unsigned int *)0xE0001004; // address of the register
static unsigned int *DWT_CONTROL =
    (unsigned int *)0xE0001000; // address of the register
static unsigned int *SCB_DEMCR =
    (unsigned int *)0xE000EDFC; // address of the register

/**
 * Function to compute and return the measured time
 */
void init_timer();

/**
 * Function to start the timer
 */
void start_timer();

/**
 * Function to stop the timer
 */
void stop_timer();

/**
 * Function to compute and return the measured time
 *
 * @return Passed cycles
 */
uint32_t get_cycles();

#endif /* CycleCounter_H */
```

## src/algorithm.c
```c
../../algorithm/c_implementation/algorithm.c
```

## src/algorithm.h
```c
../../algorithm/c_implementation/algorithm.h
```

## src/battery.c
```c
/*
 * Copyright (c) 2018-2019 Peter Bigot Consulting, LLC
 * Copyright (c) 2019-2020 Nordic Semiconductor ASA
 *
 * SPDX-License-Identifier: Apache-2.0
 */

#include <math.h>
#include <stdio.h>
#include <stdlib.h>

#include <zephyr/kernel.h>
#include <zephyr/init.h>
#include <zephyr/drivers/gpio.h>
#include <zephyr/drivers/adc.h>
#include <zephyr/drivers/sensor.h>
#include <zephyr/logging/log.h>

#include "battery.h"

LOG_MODULE_REGISTER(BATTERY, CONFIG_ADC_LOG_LEVEL);

#define VBATT DT_PATH(vbatt)
#define ZEPHYR_USER DT_PATH(zephyr_user)


/* Other boards may use dividers that only reduce battery voltage to
 * the maximum supported by the hardware (3.6 V)
 */
#define BATTERY_ADC_GAIN ADC_GAIN_1_6

struct io_channel_config {
	uint8_t channel;
};

struct divider_config {
	struct io_channel_config io_channel;
	struct gpio_dt_spec power_gpios;
	/* output_ohm is used as a flag value: if it is nonzero then
	 * the battery is measured through a voltage divider;
	 * otherwise it is assumed to be directly connected to Vdd.
	 */
	uint32_t output_ohm;
	uint32_t full_ohm;
};

static const struct divider_config divider_config = {
#if DT_NODE_HAS_STATUS(VBATT, okay)
	.io_channel = {
		DT_IO_CHANNELS_INPUT(VBATT),
	},
	.power_gpios = GPIO_DT_SPEC_GET_OR(VBATT, power_gpios, {}),
	.output_ohm = DT_PROP(VBATT, output_ohms),
	.full_ohm = DT_PROP(VBATT, full_ohms),
#else /* /vbatt exists */
	.io_channel = {
		DT_IO_CHANNELS_INPUT(ZEPHYR_USER),
	},
#endif /* /vbatt exists */
};

struct divider_data {
	const struct device *adc;
	struct adc_channel_cfg adc_cfg;
	struct adc_sequence adc_seq;
	int16_t raw;
};
static struct divider_data divider_data = {
	.adc = DEVICE_DT_GET(DT_IO_CHANNELS_CTLR(VBATT)),
};

static int divider_setup(void)
{
	const struct divider_config *cfg = &divider_config;
	const struct io_channel_config *iocp = &cfg->io_channel;
	struct divider_data *ddp = &divider_data;
	struct adc_sequence *asp = &ddp->adc_seq;
	struct adc_channel_cfg *accp = &ddp->adc_cfg;
	int rc;

	if (!device_is_ready(ddp->adc)) {
		LOG_ERR("ADC device is not ready %s", ddp->adc->name);
		return -ENOENT;
	}

	*asp = (struct adc_sequence){
		.channels = BIT(0),
		.buffer = &ddp->raw,
		.buffer_size = sizeof(ddp->raw),
		.oversampling = 4,
		.calibrate = true,
	};

	*accp = (struct adc_channel_cfg){
		.gain = BATTERY_ADC_GAIN,
		.reference = ADC_REF_INTERNAL,
		.acquisition_time = ADC_ACQ_TIME(ADC_ACQ_TIME_MICROSECONDS, 40),
	};

	if (cfg->output_ohm != 0) {
		accp->input_positive = SAADC_CH_PSELP_PSELP_AnalogInput0
			+ iocp->channel;
	} else {
		accp->input_positive = SAADC_CH_PSELP_PSELP_VDD;
	}

	asp->resolution = 14;

	rc = adc_channel_setup(ddp->adc, accp);
	return rc;
}

static bool battery_ok;

static int battery_setup(void)
{
	int rc = divider_setup();

	battery_ok = (rc == 0);
	return rc;
}

SYS_INIT(battery_setup, APPLICATION, CONFIG_APPLICATION_INIT_PRIORITY);

int battery_sample(void)
{
	int rc = -ENOENT;

	if (battery_ok) {
		struct divider_data *ddp = &divider_data;
		const struct divider_config *dcp = &divider_config;
		struct adc_sequence *sp = &ddp->adc_seq;

		rc = adc_read(ddp->adc, sp);
		sp->calibrate = false;
		if (rc == 0) {
			int32_t val = ddp->raw;

			adc_raw_to_millivolts(adc_ref_internal(ddp->adc),
					      ddp->adc_cfg.gain,
					      sp->resolution,
					      &val);

			if (dcp->output_ohm != 0) {
				rc = val * (uint64_t)dcp->full_ohm
					/ dcp->output_ohm;
				LOG_INF("raw %u ~ %u mV => %d mV\n",
					ddp->raw, val, rc);
			} else {
				rc = val;
				LOG_INF("raw %u ~ %u mV\n", ddp->raw, val);
			}
		}
	}

	return rc;
}

unsigned int battery_level_pptt(unsigned int batt_mV,
				const struct battery_level_point *curve)
{
	const struct battery_level_point *pb = curve;

	if (batt_mV >= pb->lvl_mV) {
		/* Measured voltage above highest point, cap at maximum. */
		return pb->lvl_pptt;
	}
	/* Go down to the last point at or below the measured voltage. */
	while ((pb->lvl_pptt > 0)
	       && (batt_mV < pb->lvl_mV)) {
		++pb;
	}
	if (batt_mV < pb->lvl_mV) {
		/* Below lowest point, cap at minimum */
		return pb->lvl_pptt;
	}

	/* Linear interpolation between below and above points. */
	const struct battery_level_point *pa = pb - 1;

	return pb->lvl_pptt
	       + ((pa->lvl_pptt - pb->lvl_pptt)
		  * (batt_mV - pb->lvl_mV)
		  / (pa->lvl_mV - pb->lvl_mV));
}
```

## src/battery.h
```c
/*
 * Copyright (c) 2018-2019 Peter Bigot Consulting, LLC
 *
 * SPDX-License-Identifier: Apache-2.0
 */

#ifndef APPLICATION_BATTERY_H_
#define APPLICATION_BATTERY_H_

/** Measure the battery voltage.
 *
 * @return the battery voltage in millivolts, or a negative error
 * code.
 */
int battery_sample(void);

/** A point in a battery discharge curve sequence.
 *
 * A discharge curve is defined as a sequence of these points, where
 * the first point has #lvl_pptt set to 10000 and the last point has
 * #lvl_pptt set to zero.  Both #lvl_pptt and #lvl_mV should be
 * monotonic decreasing within the sequence.
 */
struct battery_level_point {
	/** Remaining life at #lvl_mV. */
	uint16_t lvl_pptt;

	/** Battery voltage at #lvl_pptt remaining life. */
	uint16_t lvl_mV;
};

/** Calculate the estimated battery level based on a measured voltage.
 *
 * @param batt_mV a measured battery voltage level.
 *
 * @param curve the discharge curve for the type of battery installed
 * on the system.
 *
 * @return the estimated remaining capacity in parts per ten
 * thousand.
 */
unsigned int battery_level_pptt(unsigned int batt_mV,
				const struct battery_level_point *curve);

#endif /* APPLICATION_BATTERY_H_ */
```
